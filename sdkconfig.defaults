## sdkconfig.defaults
```kconfig
# ESP32-P4 Configuration
CONFIG_IDF_TARGET="esp32p4"

# CRITICAL: Enable experimental features for PSRAM 200MHz
CONFIG_IDF_EXPERIMENTAL_FEATURES=y

# PSRAM Configuration - CRITICAL FOR SMOOTH ANIMATIONS
CONFIG_SPIRAM=y
CONFIG_SPIRAM_MODE_HEX=y
CONFIG_SPIRAM_SPEED_200M=y
CONFIG_SPIRAM_XIP_FROM_PSRAM=y
CONFIG_SPIRAM_MALLOC_ALWAYSINTERNAL=0
CONFIG_SPIRAM_TRY_ALLOCATE_WIFI_LWIP=y

# Cache Configuration - CRITICAL FOR PERFORMANCE
CONFIG_CACHE_L2_CACHE_256KB=y
CONFIG_CACHE_L2_CACHE_LINE_128B=y

# Flash Configuration
CONFIG_ESPTOOLPY_FLASHSIZE_16MB=y
CONFIG_ESPTOOLPY_FLASHMODE_QIO=y
CONFIG_ESPTOOLPY_FLASHFREQ_80M=y

# Partition Table
CONFIG_PARTITION_TABLE_CUSTOM=y
CONFIG_PARTITION_TABLE_CUSTOM_FILENAME="partitions.csv"

# FreeRTOS Configuration
CONFIG_FREERTOS_HZ=1000
CONFIG_FREERTOS_UNICORE=n
CONFIG_FREERTOS_USE_TRACE_FACILITY=y
CONFIG_FREERTOS_USE_STATS_FORMATTING_FUNCTIONS=y
CONFIG_FREERTOS_VTASKLIST_INCLUDE_COREID=y
CONFIG_FREERTOS_GENERATE_RUN_TIME_STATS=y

# ESP32-P4 Specific
CONFIG_ESP32P4_REV_MIN_0=y

# Logging
CONFIG_LOG_DEFAULT_LEVEL_INFO=y
CONFIG_LOG_MAXIMUM_LEVEL_INFO=y

# Compiler Optimization - CRITICAL
CONFIG_COMPILER_OPTIMIZATION_PERF=y

# Memory Configuration
CONFIG_ESP_SYSTEM_ALLOW_RTC_FAST_MEM_AS_HEAP=y

# Main task stack size
CONFIG_ESP_MAIN_TASK_STACK_SIZE=10240

# LVGL Configuration - CRITICAL FOR SMOOTH ANIMATIONS
CONFIG_LV_USE_CLIB_MALLOC=y
CONFIG_LV_USE_CLIB_STRING=y
CONFIG_LV_USE_CLIB_SPRINTF=y
CONFIG_LV_DEF_REFR_PERIOD=15
CONFIG_LV_OS_FREERTOS=y
CONFIG_LV_DRAW_SW_DRAW_UNIT_CNT=2
CONFIG_LV_ATTRIBUTE_FAST_MEM_USE_IRAM=y
CONFIG_LV_FONT_MONTSERRAT_14=y

# LVGL Port Task Configuration - CRITICAL: Increase stack for JPEG decoder
CONFIG_LV_PORT_TASK_STACK_SIZE=12288

# ============ WiFi Configuration (ESP32-C6 via ESP-Hosted) ============
# ESP-Hosted remote WiFi configuration
CONFIG_WIFI_RMT_STATIC_RX_BUFFER_NUM=10
CONFIG_WIFI_RMT_RX_BA_WIN=6

# ESP WiFi settings
CONFIG_ESP_WIFI_ENABLED=y
CONFIG_ESP_WIFI_STATIC_RX_BUFFER_NUM=10
CONFIG_ESP_WIFI_DYNAMIC_RX_BUFFER_NUM=32
CONFIG_ESP_WIFI_TX_BUFFER_TYPE=1
CONFIG_ESP_WIFI_DYNAMIC_TX_BUFFER_NUM=32
CONFIG_ESP_WIFI_AMPDU_TX_ENABLED=y
CONFIG_ESP_WIFI_AMPDU_RX_ENABLED=y

# Network Configuration
CONFIG_LWIP_LOCAL_HOSTNAME="Winesp32-Kolhoz"
CONFIG_LWIP_TCP_OOSEQ_MAX_PBUFS=4

# ============ Camera Configuration (MIPI-CSI) ============
# JC4880P443C board uses OV02C10 camera via MIPI-CSI (from demo firmware)
CONFIG_ESP_VIDEO_ENABLE_MIPI_CSI_VIDEO_DEVICE=y
CONFIG_ESP_VIDEO_ENABLE_ISP_VIDEO_DEVICE=y
CONFIG_ESP_VIDEO_ENABLE_ISP_PIPELINE_CONTROLLER=y
CONFIG_ESP_VIDEO_ENABLE_DVP_VIDEO_DEVICE=n

# Enable OV02C10 sensor (used in JC4880P443C board - from demo sdkconfig)
CONFIG_CAMERA_OV02C10=y
CONFIG_CAMERA_OV02C10_AUTO_DETECT=y
CONFIG_CAMERA_OV02C10_AUTO_DETECT_MIPI_INTERFACE_SENSOR=y
CONFIG_CAMERA_OV02C10_MIPI_RAW10_1288x728_30FPS=y
CONFIG_CAMERA_OV02C10_CSI_LINESYNC_ENABLE=y
CONFIG_CAMERA_OV02C10_ISP_AF_ENABLE=y
CONFIG_CAMERA_OV02C10_ABSOLUTE_GAIN_LIMIT=66016
CONFIG_CAMERA_OV02C10_ANA_GAIN_PRIORITY=y
CONFIG_CAMERA_OV02C10_DEFAULT_IPA_JSON_CONFIGURATION_FILE=y

# Camera XCLK configuration
CONFIG_CAMERA_XCLK_USE_ESP_CLOCK_ROUTER=y

# ============ Additional Settings ============
CONFIG_VFS_MAX_COUNT=15
CONFIG_FATFS_LFN_HEAP=y

# ============ LVGL File System and Image Decoders ============
# Enable POSIX file system driver for loading images from LittleFS/SD
CONFIG_LV_USE_FS_POSIX=y
CONFIG_LV_FS_POSIX_LETTER=65

# Enable image decoders
CONFIG_LV_USE_TJPGD=y
CONFIG_LV_USE_LODEPNG=y
CONFIG_LV_USE_BMP=y

# ============ SSL/TLS Configuration ============
# Allow insecure connections (skip certificate verification)
CONFIG_ESP_TLS_INSECURE=y
CONFIG_ESP_TLS_SKIP_SERVER_CERT_VERIFY=y
CONFIG_MBEDTLS_SSL_KEEP_PEER_CERTIFICATE=n

# ============ Bluetooth Configuration (via ESP32-C6 ESP-Hosted) ============
# Enable BT stack on host (ESP32-P4), controller runs on ESP32-C6
CONFIG_BT_ENABLED=y
CONFIG_BT_CONTROLLER_DISABLED=y
CONFIG_BT_BLUEDROID_ENABLED=n
CONFIG_BT_NIMBLE_ENABLED=y
CONFIG_BT_NIMBLE_TRANSPORT_UART=n

# NimBLE configuration
CONFIG_BT_NIMBLE_MAX_CONNECTIONS=3
CONFIG_BT_NIMBLE_MAX_BONDS=3
CONFIG_BT_NIMBLE_MAX_CCCDS=8
CONFIG_BT_NIMBLE_L2CAP_COC_MAX_NUM=2
CONFIG_BT_NIMBLE_ROLE_PERIPHERAL=y
CONFIG_BT_NIMBLE_ROLE_CENTRAL=y
CONFIG_BT_NIMBLE_ROLE_OBSERVER=y
CONFIG_BT_NIMBLE_ROLE_BROADCASTER=y
CONFIG_BT_NIMBLE_NVS_PERSIST=y
CONFIG_BT_NIMBLE_SM_LEGACY=y
CONFIG_BT_NIMBLE_SM_SC=y

# ESP-Hosted BT support - VHCI transport to ESP32-C6
CONFIG_ESP_HOSTED_ENABLE_BT_NIMBLE=y
CONFIG_ESP_HOSTED_NIMBLE_HCI_VHCI=y
```
